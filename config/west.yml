## config/west.yml
```yaml
manifest:
  remotes:
    - name: zmkfirmware
      url-base: https://github.com/zmkfirmware
    - name: refil
      url-base: https://github.com/zemackdaddy
  projects:
    - name: zmk
      remote: refil
      revision: adv360-z3.2
      import: app/west.yml
  self:
    path: config
```
